## west.yml
```yaml
manifest:
  version: "1.2"

  remotes:
    - name: ingchips
      url-base: https://github.com/ingchips
    - name: zenghui
      url-base: git@github.com:ZenghuiJIA

  projects:
    - name: zephyr
      remote: zenghui
      repo-path: zephyr
      revision: dev_ingchips_mainline
      path: zephyr
      import:
        name-allowlist:
          - cmsis
          - cmsis_6

    - name: hal_ingchips
      remote: ingchips
      repo-path: ING918XX_SDK_SOURCE
      revision: v9.1.1
      path: modules/hal/ingchips
      clone-depth: 1

  self:
    path: manifest
```
